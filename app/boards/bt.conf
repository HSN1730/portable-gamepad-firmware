## app/boards/bt.conf
```kconfig
CONFIG_BT=y
CONFIG_BT_L2CAP_TX_BUF_COUNT=5
CONFIG_BT_PERIPHERAL=y
CONFIG_BT_DEVICE_NAME_DYNAMIC=y
CONFIG_BT_DEVICE_APPEARANCE=964
CONFIG_BT_BAS=y
CONFIG_BT_SMP=y
CONFIG_BT_SETTINGS=y
CONFIG_BT_PRIVACY=y
CONFIG_BT_FILTER_ACCEPT_LIST=y
CONFIG_BT_GAP_PERIPHERAL_PREF_PARAMS=n
CONFIG_BT_GAP_AUTO_UPDATE_CONN_PARAMS=n
CONFIG_BT_LE_EXTENDED_FEAT_SET=y
CONFIG_BT_SUBRATING=y
CONFIG_BT_FRAME_SPACE_UPDATE=y
CONFIG_BT_SHORTER_CONNECTION_INTERVALS=y
CONFIG_BT_USER_PHY_UPDATE=y
```

## app/boards/bt_ncs.conf
```kconfig
CONFIG_BT_HIDS=y
CONFIG_BT_GATT_UUID16_POOL_SIZE=40
CONFIG_BT_GATT_CHRC_POOL_SIZE=20
CONFIG_BT_CONN_CTX=y
CONFIG_BT_HIDS_DEFAULT_PERM_RW_ENCRYPT=y
CONFIG_BT_RADIO_NOTIFICATION_CONN_CB=y
```

## app/boards/xiao_nrf54lm20a_nrf54lm20a_cpuapp.conf
```kconfig
CONFIG_BT_LL_SW_SPLIT=n

CONFIG_SENSOR=y
CONFIG_PGF_BATTERY_LEVEL_REPORTING_PMIC=y
```
